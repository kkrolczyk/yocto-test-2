## layers/conf/bblayers.conf
```bitbake
# POKY_BBLAYERS_CONF_VERSION is increased each time build/conf/bblayers.conf changes incompatibly
# POKY_BBLAYERS_CONF_VERSION = "2"

BBPATH = "${TOPDIR}"
BBFILES ?= ""

# use BSPDIR - cause yocto doesn't like .. in bblayers
BSPDIR := "${@os.path.abspath(os.path.dirname(d.getVar('FILE', True)) + '/../..')}"

# no empty lines, or stupid bb parser breaks.

# OE core
BBLAYERS ?= " \
  ${BSPDIR}/upstream/openembedded-core/meta \
"

JUCR_LAYERS = " \
  ${BSPDIR}/layers/meta-jucr-hw \
  ${BSPDIR}/layers/meta-jucr-sw \
  ${BSPDIR}/layers/meta-jucr-os \
"

# meta-yocto-bsp is required by meta-aws layer
META_YOCTO_LAYERS = " \
  ${BSPDIR}/upstream/meta-yocto/meta-poky \
  ${BSPDIR}/upstream/meta-yocto/meta-yocto-bsp \
"

# those are required by AWS Greengrass recipe
AWS_PLUS_OE_DEPS_LAYERS = " \
  ${BSPDIR}/upstream/meta-openembedded/meta-oe \
  ${BSPDIR}/upstream/meta-openembedded/meta-filesystems \
  ${BSPDIR}/upstream/meta-openembedded/meta-python \
  ${BSPDIR}/upstream/meta-openembedded/meta-networking \
  ${BSPDIR}/upstream/meta-openembedded/meta-multimedia \
  ${BSPDIR}/upstream/meta-aws/ \
"

BBLAYERS:append = "${JUCR_LAYERS}"
BBLAYERS:append = "${META_YOCTO_LAYERS}"
BBLAYERS:append = "${AWS_PLUS_OE_DEPS_LAYERS}"

###################################### keep unused below

# poky - for now will not be added. It is meta-oe/meta + meta-yocto
POKY_LAYERS = "\
  ${BSPDIR}/upstream/poky/meta-poky \
   ${BSPDIR}/upstream/meta-yocto/meta-yocto-bsp \
"

# meta-imx-bsp depends on meta-security
IMX_LAYERS = " \
  ${BSPDIR}/upstream/meta-security \
  ${BSPDIR}/upstream/meta-imx/meta-imx-bsp \
"

FREESCALE_LAYERS = " \
  ${BSPDIR}/upstream/meta-freescale \
  ${BSPDIR}/upstream/meta-freescale-3rdparty \
  ${BSPDIR}/upstream/meta-freescale-distro \
"
  
# depend a lot on imx and other freescale
VARISCITE_LAYERS = " \
  ${BSPDIR}/upstream/meta-variscite-bsp-imx \
  ${BSPDIR}/upstream/meta-variscite-sdk-imx \
  ${BSPDIR}/upstream/meta-variscite-bsp-common \
  ${BSPDIR}/upstream/meta-variscite-sdk-common \
  ${BSPDIR}/upstream/meta-variscite-hab \
"
```

## layers/conf/build-old1/conf/local.conf
```bitbake
#MACHINE ?= "qemuarm"
MACHINE ?= "qemuarm64"
#MACHINE ?= "qemumips"
#MACHINE ?= "qemumips64"
#MACHINE ?= "qemuppc"
#MACHINE ?= "qemux86"
#MACHINE ?= "qemux86-64"

# imx8mm-var-dart

# This sets the default machine to be qemux86-64 if no other machine is selected:
MACHINE ??= "qemux86-64"



DL_DIR ?= "/opt/yocto/downloads"

SSTATE_DIR ?= "/opt/yocto/sstate-cache"

# distro != image, + `DISTRO != distro_name`, DISTRO == filename in distro dir without conf

DISTRO ?= "jucros-minimal"

# should be already defined by distro?
EXTRA_IMAGE_FEATURES ?= "debug-tweaks"

# is it needed, or does it have a default
#PATCHRESOLVE = "noop"
#CONF_VERSION = "2"

# Monitor the disk space during the build. If there is less that 1GB of space or less
# than 100K inodes in any key build location (TMPDIR, DL_DIR, SSTATE_DIR), gracefully
# shutdown the build. If there is less than 100MB or 1K inodes, perform a hard halt
# of the build. The reason for this is that running completely out of space can corrupt
# files and damages the build in ways which may not be easily recoverable.
# It's necessary to monitor /tmp, if there is no space left the build will fail
# with very exotic errors.
BB_DISKMON_DIRS ??= "\
    STOPTASKS,${TMPDIR},10G,100K \
    STOPTASKS,${DL_DIR},10G,100K \
    STOPTASKS,${SSTATE_DIR},10G,100K \
    STOPTASKS,/tmp,1G,100K \
    HALT,${TMPDIR},1G,1K \
    HALT,${DL_DIR},1G,1K \
    HALT,${SSTATE_DIR},1G,1K \
    HALT,/tmp,1G,1K"

ACCEPT_FSL_EULA = "1"
```

## layers/conf/local.conf
```bitbake
# MACHINE ?= "qemuarm64"
# MACHINE ?= "qemux86-64"

# DISTRO ?= "jucros-test"
# DISTRO ?= "jucros-prod"

# QEMU can simulate various ARM machines. qemu-system-aarch64, qemu-system-arm
# TODO: document if above applies to what machine is simulated (likely),
# or on what host should it run (unlikely)
# So the image for ARM should be run on arm qemu, despite host being x86-64
# imx8mm-var-dart (used by veriscite)
# TODO for proper abstraction - JUCR os should define own machine(s)



# TODO:
# This sets the default machine to be qemux86-64 if no other machine is selected:
MACHINE ??= "qemux86-64"
DISTRO ?= "jucr-os-base"


USER_CLASSES ?= "buildstats"


# TODO: figure out the way, for this to work in CI
DL_DIR ?= "/opt/yocto/downloads"
SSTATE_DIR ?= "/opt/yocto/sstate-cache"


# is it needed, or does it have a default
#PATCHRESOLVE = "noop"
#CONF_VERSION = "2"

# Monitor the disk space during the build.
BB_DISKMON_DIRS ??= "\
    STOPTASKS,${TMPDIR},10G,100K \
    STOPTASKS,${DL_DIR},10G,100K \
    STOPTASKS,${SSTATE_DIR},10G,100K \
    STOPTASKS,/tmp,1G,100K \
    HALT,${TMPDIR},1G,1K \
    HALT,${DL_DIR},1G,1K \
    HALT,${SSTATE_DIR},1G,1K \
    HALT,/tmp,1G,1K"

# TODO future
# Runtime testing of images
# Shared-state files from other locations
# Yocto Project SState Mirror
# site.conf
```

## layers/meta-jucr-hw/conf/layer.conf
```bitbake
# We have a conf and classes directory, add to BBPATH
BBPATH .= ":${LAYERDIR}"

# We have recipes-* directories, add to BBFILES
BBFILES += "${LAYERDIR}/recipes-*/*/*.bb \
            ${LAYERDIR}/recipes-*/*/*.bbappend"

# TODO: double check, if yocto hasn't got stupid name limitation, preventing dashes

BBFILE_COLLECTIONS += "jucr-hw"
BBFILE_PATTERN_jucr-hw = "^${LAYERDIR}/"
BBFILE_PRIORITY_jucr-hw = "1"

LAYERVERSION_jucr-hw = "1"
LAYERDEPENDS_jucr-hw = "core"
LAYERSERIES_COMPAT_jucr-hw = "scarthgap"
```

## layers/meta-jucr-os/conf/distro/features-default.inc
```bitbake
DISTRO_EXTRA_RDEPENDS += "packagegroup-core-boot"

# See bottom of this file for full list
DISTRO_FEATURES = " 3g ipv4 ipv6 ldconfig ppp systemd usbgadget usbhost wifi xattr "

# TODO: not needed, we define only which we want above...  #  multiarch vulkan  virtualization   pam/selinux/apparmor/smack/acl/seccomp
# DISTRO_FEATURES_DEFAULT:remove = " alsa api-documentation bluetooth cramfs directfb ipsec nfs opengl ptest smbfs x11 wayland    nfc "
# see "features.list" for descriptions
# What do we do with (do we want them?):
#                 -> ext2 keyboard pci pcmcia usrmerge(is it wanted?) 3g? nfc?

DISTRO_FEATURES_BACKFILL_CONSIDERED += "gobject-introspection-data pulseaudio bluez4 bluez5"

# required for AWS Greengrass
DISTRO_FEATURES += "systemd ntp-systemd"
DISTRO_FEATURES_BACKFILL_CONSIDERED = "sysvinit"
# TODO: consider (for base!) "mdev-busybox"
INIT_MANAGER = "systemd"
VIRTUAL-RUNTIME_init_manager = "systemd"
VIRTUAL-RUNTIME_initscripts = ""


# TODO
PREFERRED_PROVIDER_virtual/kernel = "linux-yocto"
PREFERRED_VERSION_linux-yocto ?= "6.6%"
# PREFERRED_PROVIDER_virtual/kernel = "linux-kernel"

# use DEBs / RPMs (package_rpm) instead of IPK?
# PACKAGE_CLASSES ?= "package_deb"

# smaller (also when no pkg management on target, like on  core-image-minimal)
PACKAGE_CLASSES += "package_ipk"


# see poky-tiny for reasons
USE_NLS = "no"
IMAGE_LINGUAS = ""
ENABLE_WIDEC = "false"
ENABLE_WIDEC:class-native = "true"





# TODO: ARE THOSE NEEDED?
# LOCALCONF_VERSION = "2"

# Disable python usage in opkg-utils since it won't build with tiny config
# PACKAGECONFIG:remove:pn-opkg-utils = "python"

## IDK rather not
## DISTRO_FEATURES:class-native = "${DISTRO_FEATURES_DEFAULT} ${POKY_DEFAULT_DISTRO_FEATURES}"










# ------------------------------------------------------------------------

# DISTRO_FEATURES
# alsa: Include ALSA support
# api-documentation: Enables generation of API documentation
# bluetooth: Include integrated bluetooth support
# cramfs: Include CramFS support
# directfb: Include DirectFB support
# ext2: tools
# ipsec: Include IPSec support
# ipv6: Include IPv6 support
# keyboard: Include keyboard support
# ldconfig: Include support for ldconfig and ld.so.conf on the target.
# nfs: Include NFS client support
# opengl: Include the Open Graphics Library
# pci: Include PCI bus support
# pcmcia: Include PCMCIA/CompactFlash support
# ppp: Include PPP dialup support
# ptest: Enables building the package tests
# smbfs: Include SMB networks client support
# systemd: Include support for this init manager
# usbgadget: Include USB Gadget Device support (for USB networking/serial/storage).
# usbhost: Include USB Host support (allows to connect external keyboard, mouse, storage, network etc).
# usrmerge: Merges the /bin, /sbin, /lib, and /lib64 directories into their respective counterparts in the /usr directory to provide better package and application compatibility
# wayland: Include the Wayland
# wifi: Include integrated WiFi support
# x11: Include the X server and libraries
# zeroconf ??
```

## layers/meta-jucr-os/conf/distro/jucr-os-base.conf
```bitbake
DISTRO = "jucr-os-base"
DISTRO_NAME="jucr-os-base"
DISTRO_VERSION="2024.12"

include conf/distro/features-default.inc

SKIP_RECIPE[jucr-image-prod] = "not buildable with jucros-base"
SKIP_RECIPE[jucr-image-test] = "not buildable with jucros-base"

# dbus-broker_git vs other alt?

# TODO: needed? How should one get it, if not pulling poky, but meta-yocto?
# INHERIT += "poky-sanity"

# TODO: needed?
#  require conf/distro/include/poky-world-exclude.inc
#  require conf/distro/include/no-static-libs.inc
#  require conf/distro/include/yocto-uninative.inc
#  require conf/distro/include/security_flags.inc
#  INHERIT += "uninative"

# Distro config is evaluated after the machine config
```

## layers/meta-jucr-os/conf/distro/jucr-os-prod.conf
```bitbake
DISTRO = "jucr-os-prod"
DISTRO_NAME = "jucr-os-prod"
DISTRO_VERSION = "2024.12"

MAINTAINER = "JUCR <embedded@jucr.de>"

include conf/distro/features-default.inc
include conf/distro/rules/licenses.inc
```

## layers/meta-jucr-os/conf/distro/jucr-os-test.conf
```bitbake
DISTRO = "jucr-os-test"
DISTRO_NAME = "jucr-os-test"
DISTRO_VERSION = "2024.12"

include conf/distro/features-default.inc
include conf/distro/rules/sdk.inc
include conf/distro/rules/qemu.inc
```

## layers/meta-jucr-os/conf/distro/rules/licenses.inc
```bitbake
# This file contains all the settings regarding
# licenses, blacklisting/whitelisting a.s.o.

# Blacklist a set of license that we don't want in the image
INCOMPATIBLE_LICENSE ?= "\
    GPL-3.0 \
    LGPL-3.0 \
    AGPL-3.0 \
    MPL-1.1 \
    SGI-1 \
    CECILL-2.0 \
    CDDL-1.1 \
    EPL-1.0 \
    CPL-1.0 \
"

# whitelist GPL licenses for some packages
WHITELIST_GPL-3.0 ?= "\
    binutils \
    gdb \
    gdbserver \
"
WHITELIST_LGPL-3.0 ?= "gdb"

LICENSE_FLAGS_WHITELIST += "\
"
```

## layers/meta-jucr-os/conf/distro/rules/qemu.inc
```bitbake
# Distro wide settings for qemu

# increase original memory from 256 to 2048
QB_MEM ?= "-m 2048"

# Always use kvm for speediness
QEMU_USE_KVM ?= "1"

# Enable libusb support (needed for usb passthrough with qemu-xhci)
PACKAGECONFIG_append_pn-qemu-native = " libusb"
PACKAGECONFIG_append_pn-nativesdk-qemu = " libusb"
```

## layers/meta-jucr-os/conf/distro/rules/sdk.inc
```bitbake
SDK_VERSION="jucr-sdk.2024.12"
SDKIMAGE_FEATURES += "package-management"

# TCLIBC = "libc"
# FULL_OPTIMIZATION="-Os -pipe ${DEBUG_FLAGS}"
# SDK_NAME = "${DISTRO}-${TCLIBC}-${SDKMACHINE}-${IMAGE_BASENAME}-${TUNE_PKGARCH}-${MACHINE}"
# SDKPATHINSTALL = "/opt/${DISTRO}/${SDK_VERSION}"

# SDK_VENDOR = "-jucrsdk"
# SDK_VERSION = "${@d.getVar('DISTRO_VERSION').replace('snapshot-${METADATA_REVISION}', 'snapshot')}"
# SDK_VERSION[vardepvalue] = "${SDK_VERSION}"
```

## layers/meta-jucr-os/conf/layer.conf
```bitbake
# We have a conf and classes directory, add to BBPATH
BBPATH .= ":${LAYERDIR}"

# We have recipes-* directories, add to BBFILES
BBFILES += "${LAYERDIR}/recipes-*/*/*.bb ${LAYERDIR}/recipes-*/*/*.bbappend ${LAYERDIR}/recipes-*/*.bb"

# TODO: double check, if yocto hasn't got stupid name limitation, preventing dashes

BBFILE_COLLECTIONS += "jucr-os"
BBFILE_PATTERN_jucr-os = "^${LAYERDIR}/"
BBFILE_PRIORITY_jucr-os = "1"

LAYERVERSION_jucr-os = "1"
LAYERDEPENDS_jucr-os = "core"
# LAYERDEPENDS_jucr-os = "core yocto"   no need to dep on poky
LAYERSERIES_COMPAT_jucr-os = "scarthgap"
```

## layers/meta-jucr-sw/conf/layer.conf
```bitbake
# We have a conf and classes directory, add to BBPATH
BBPATH .= ":${LAYERDIR}"

# We have recipes-* directories, and we have packagegroups = add to BBFILES
BBFILES += "${LAYERDIR}/recipes-*/*/*.bb ${LAYERDIR}/recipes-*/*/*.bbappend ${LAYERDIR}/packagegroups/*.bb"

# TODO: double check, if yocto hasn't got stupid name limitation, preventing dashes

BBFILE_COLLECTIONS += "jucr-sw"
BBFILE_PATTERN_jucr-sw = "^${LAYERDIR}/"
BBFILE_PRIORITY_jucr-sw = "1"

LAYERVERSION_jucr-sw = "1"
LAYERDEPENDS_jucr-sw = "core"
LAYERSERIES_COMPAT_jucr-sw = "scarthgap"


# The layer could enforce adding SW to image, but we are leaving this decision
# to be done by respective image recipes
#CORE_IMAGE_EXTRA_INSTALL += "\
#    greengrass \
#    starman \
#"
```
